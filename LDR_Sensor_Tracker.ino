#include <Servo.h> // นำเข้าห้องสมุด Servo เพื่อควบคุมเซอร์โวมอเตอร์
Servo myservo; // สร้างตัวแปร myservo สำหรับเซอร์โวมอเตอร์
#define ldr1 A0 // กำหนดขา A0 ให้เป็น LDR1 (เซนเซอร์ทางทิศตะวันออก)
#define ldr2 A1 // กำหนดขา A1 ให้เป็น LDR2 (เซนเซอร์ทางทิศตะวันตก)
int pos = 90; // กำหนดตำแหน่งเริ่มต้นของการเคลื่อนไหวของเซอร์โวมอเตอร์ (ตำแหน่ง 90 องศา คือกลาง)
int tolerance = 20; // กำหนดค่าความผิดพลาด (tolerance) ให้เป็น 20 เพื่อไม่ให้เซอร์โวมอเตอร์เคลื่อนไหวถ้าค่าของ LDR ต่างกันน้อยเกินไป
void setup() {
    myservo.attach(9); // กำหนดเซอร์โวมอเตอร์ให้เชื่อมต่อกับขา 9
    pinMode(ldr1, INPUT); // ตั้งค่า LDR1 (East) เป็นอินพุต
    pinMode(ldr2, INPUT); // ตั้งค่า LDR2 (West) เป็นอินพุต
    myservo.write(pos); // กำหนดตำแหน่งเริ่มต้นของเซอร์โวมอเตอร์ที่ 90 องศา
    delay(1000); // หน่วงเวลา 1 วินาทีให้เซอร์โวมอเตอร์เคลื่อนไหวไปที่ตำแหน่งเริ่มต้น
}
void loop() {
    int val1 = analogRead(ldr1); // อ่านค่าจาก LDR1 (East)
    int val2 = analogRead(ldr2); // อ่านค่าจาก LDR2 (West)

    if ((abs(val1 - val2) <= tolerance) || (abs(val2 - val1) <= tolerance)) {
        // ถ้าค่าความต่างระหว่าง LDR1 และ LDR2 น้อยกว่าค่าความผิดพลาด (tolerance) 
        // จะไม่เคลื่อนไหวเซอร์โวมอเตอร์
    } else {
        if (val1 > val2) {
            pos = pos + 1; // ถ้า LDR1 มีแสงมากกว่า LDR2 ให้หมุนเซอร์โวมอเตอร์ไปทางทิศตะวันออก
        }
        if (val1 < val2) {
            pos = pos - 1; // ถ้า LDR2 มีแสงมากกว่า LDR1 ให้หมุนเซอร์โวมอเตอร์ไปทางทิศตะวันตก
        }
    }

    // ตรวจสอบว่าเซอร์โวมอเตอร์จะไม่หมุนเกินขอบเขต (0-180 องศา)
    if (pos > 180) { pos = 180; }
    if (pos < 0) { pos = 0; }

    myservo.write(pos); // ตั้งค่าตำแหน่งใหม่ให้กับเซอร์โวมอเตอร์
    delay(50); // หน่วงเวลา 50 มิลลิวินาที
}
